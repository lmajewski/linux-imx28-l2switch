## Documentation/devicetree/bindings/net/nxp,imx28-mtip-switch.yaml
```yaml
# SPDX-License-Identifier: (GPL-2.0-only OR BSD-2-Clause)
%YAML 1.2
---
$id: http://devicetree.org/schemas/net/nxp,imx28-mtip-switch.yaml#
$schema: http://devicetree.org/meta-schemas/core.yaml#

title: NXP SoC Ethernet Switch Controller (L2 MoreThanIP switch)

maintainers:
  - Lukasz Majewski <lukma@nabladev.com>

description:
  The 2-port switch ethernet subsystem provides ethernet packet (L2)
  communication and can be configured as an ethernet switch. It provides the
  reduced media independent interface (RMII), the management data input
  output (MDIO) for physical layer device (PHY) management.

allOf:
  - $ref: ethernet-switch.yaml#/$defs/ethernet-ports

properties:
  compatible:
    const: nxp,imx28-mtip-switch

  reg:
    maxItems: 1

  phy-supply:
    description:
      Regulator that powers Ethernet PHYs.

  clocks:
    items:
      - description: Register accessing clock
      - description: Bus access clock
      - description: Output clock for external device - e.g. PHY source clock
      - description: IEEE1588 timer clock

  clock-names:
    items:
      - const: ipg
      - const: ahb
      - const: enet_out
      - const: ptp

  interrupts:
    items:
      - description: Switch interrupt
      - description: ENET0 interrupt
      - description: ENET1 interrupt

  interrupt-names:
    items:
      - const: enet_switch
      - const: enet0
      - const: enet1

  pinctrl-names: true

  ethernet-ports:
    type: object
    additionalProperties: true

    patternProperties:
      '^ethernet-port@[12]$':
        type: object
        additionalProperties: true
        properties:
          reg:
            items:
              - enum: [1, 2]
            description: MTIP L2 switch port number

        required:
          - reg
          - phy-mode
          - phy-handle

  mdio:
    type: object
    $ref: mdio.yaml#
    unevaluatedProperties: false
    description:
      Specifies the mdio bus in the switch, used as a container for phy nodes.

required:
  - compatible
  - reg
  - clocks
  - clock-names
  - interrupts
  - interrupt-names
  - mdio
  - ethernet-ports

unevaluatedProperties: false

examples:
  - |
    #include<dt-bindings/interrupt-controller/irq.h>
    #include<dt-bindings/gpio/gpio.h>
    switch@800f0000 {
        compatible = "nxp,imx28-mtip-switch";
        reg = <0x800f0000 0x20000>;
        pinctrl-names = "default";
        pinctrl-0 = <&mac0_pins_a>, <&mac1_pins_a>;
        phy-supply = <&reg_fec_3v3>;
        interrupts = <100>, <101>, <102>;
        interrupt-names = "enet_switch", "enet0", "enet1";
        clocks = <&clks 57>, <&clks 57>, <&clks 64>, <&clks 35>;
        clock-names = "ipg", "ahb", "enet_out", "ptp";

        ethernet-ports {
            #address-cells = <1>;
            #size-cells = <0>;

            mtip_port1: ethernet-port@1 {
                reg = <1>;
                label = "lan0";
                local-mac-address = [ 00 00 00 00 00 00 ];
                phy-mode = "rmii";
                phy-handle = <&ethphy0>;
            };

            mtip_port2: ethernet-port@2 {
                reg = <2>;
                label = "lan1";
                local-mac-address = [ 00 00 00 00 00 00 ];
                phy-mode = "rmii";
                phy-handle = <&ethphy1>;
            };
        };

        mdio_sw: mdio {
            #address-cells = <1>;
            #size-cells = <0>;

            reset-gpios = <&gpio2 13 GPIO_ACTIVE_LOW>;
            reset-delay-us = <25000>;
            reset-post-delay-us = <10000>;

            ethphy0: ethernet-phy@0 {
                reg = <0>;
            };

            ethphy1: ethernet-phy@1 {
                reg = <1>;
            };
        };
    };
```

## drivers/net/ethernet/freescale/mtipsw/Kconfig
```kconfig
# SPDX-License-Identifier: GPL-2.0-only
config FEC_MTIP_L2SW
	tristate "MoreThanIP L2 switch support to FEC driver"
	depends on OF
	depends on NET_SWITCHDEV
	depends on BRIDGE
	depends on SOC_IMX28 || COMPILE_TEST
	help
	  This enables support for the MoreThanIP L2 switch on i.MX
	  SoCs (e.g. i.MX287). It offloads bridging to this IP block's
	  hardware and allows switch management with standard Linux tools.
	  This switch driver can be used interchangeably with the already
	  available FEC driver, depending on the use case's requirements.
```
