/dts-v1/;
#include "imx28-xea.dtsi"

&i2c0 {
        pinctrl-names = "default";
        pinctrl-0 = <&i2c0_pins_a>;
        status = "okay";
};

&i2c1 {
        pinctrl-names = "default";
        pinctrl-0 = <&i2c1_pins_b>;
        status = "okay";
};
