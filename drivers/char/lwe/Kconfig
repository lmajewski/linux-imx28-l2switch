## drivers/char/lwe/Kconfig
```kconfig
#
# Liebherr LSB protocol drivers
#

config GPIOSYNC
	tristate "synchronize GPIO with system time"
	help
	  This driver allows to synchronize a GPIO with an
	  the system time.
```

## drivers/net/ethernet/freescale/l2_switch/Kconfig
```kconfig
config FEC_L2SWITCH
       bool "L2 Switch Ethernet Controller (of ColdFire CPUs)"
       depends on ARCH_MX28 && !FEC
       help
        Say Y here if you want to use the built-in 10/100 Ethernet Switch
        Controller on some Motorola ColdFire processors.
```
